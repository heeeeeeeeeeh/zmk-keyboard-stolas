## boards/shields/stolas/Kconfig.defconfig
```kconfig
# Copyright (c) 2022 The ZMK Contributors
# SPDX-License-Identifier: MIT

if SHIELD_STOLAS_LEFT

config ZMK_KEYBOARD_NAME
    default "Stolas"
    
config ZMK_SPLIT_ROLE_CENTRAL
    default y

endif

if SHIELD_STOLAS_LEFT || SHIELD_STOLAS_RIGHT

config ZMK_SPLIT
    default y

endif
```

## boards/shields/stolas/Kconfig.shield
```kconfig
config SHIELD_STOLAS_LEFT
    def_bool $(shields_list_contains,stolas_left)

config SHIELD_STOLAS_RIGHT
    def_bool $(shields_list_contains,stolas_right)
```
